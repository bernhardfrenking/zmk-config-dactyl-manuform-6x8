## config/boards/shields/dactyl_manuform_6x8/Kconfig.defconfig
```kconfig
if SHIELD_DACTYL_MANUFORM_6x8_RIGHT

    config ZMK_KEYBOARD_NAME
        default "Dactyl6x8"

    config ZMK_SPLIT_BLE_ROLE_CENTRAL
        default y

endif

if SHIELD_DACTYL_MANUFORM_6x8_RIGHT || SHIELD_DACTYL_MANUFORM_6x8_LEFT

    config ZMK_SPLIT
        default y

endif
```

## config/west.yml
```yaml
manifest:
  remotes:
    - name: zmkfirmware
      url-base: https://github.com/zmkfirmware
    - name: pmw3610-driver
      url-base: https://github.com/inorichi
  projects:
    - name: zmk
      remote: zmkfirmware
      revision: v0.2.1
      import: app/west.yml
    - name: zmk-pmw3610-driver
      remote: pmw3610-driver
      revision: main      
  self:
    path: config
```
